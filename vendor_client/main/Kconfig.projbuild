## vendor_client/main/Kconfig.projbuild
```kconfig
menu "Smart Home Mesh Roles"

choice SH_CONTROLLER_ROLE
    prompt "Smart-home controller role"
    default SH_ROLE_PROVISIONER_CONTROLLER
    help
        Select how the vendor_client firmware participates in the BLE Mesh network.

config SH_ROLE_PROVISIONER_CONTROLLER
    bool "Provisioner controller"

config SH_ROLE_REMOTE_CONTROLLER
    bool "Remote controller"

config SH_ROLE_GATEWAY_RELAY
    bool "Gateway relay"

endchoice

config SH_BLE_BRIDGE_ENABLE
    bool "Enable phone BLE GATT bridge"
    default y
    help
        Expose device list, state notifications, and control writes through a normal BLE GATT service.

endmenu
```

## vendor_client/sdkconfig.defaults
```kconfig
# Override some defaults so BT stack is enabled
# by default in this example
CONFIG_BT_ENABLED=y
CONFIG_BT_BTU_TASK_STACK_SIZE=4512
CONFIG_PARTITION_TABLE_SINGLE_APP_LARGE=y
CONFIG_ESP_MAIN_TASK_STACK_SIZE=8192

# Override some defaults of ESP BLE Mesh
CONFIG_BLE_MESH=y
CONFIG_BLE_MESH_PROVISIONER=y
CONFIG_BLE_MESH_MAX_PROV_NODES=32
CONFIG_BLE_MESH_SUPPORT_BLE_ADV=y
CONFIG_BLE_MESH_PB_GATT=y
CONFIG_BLE_MESH_TX_SEG_MSG_COUNT=10
CONFIG_BLE_MESH_RX_SEG_MSG_COUNT=10
CONFIG_BLE_MESH_CFG_CLI=y
CONFIG_BLE_MESH_SETTINGS=y
CONFIG_BLE_MESH_STORE_TIMEOUT=0
CONFIG_BLE_MESH_SEQ_STORE_RATE=0
CONFIG_BLE_MESH_RPL_STORE_TIMEOUT=0
```

## vendor_client/vendor_client_provisioner/components/device_controller/Kconfig.projbuild
```kconfig
menu "Device Controller Configuration"

    config DEVICE_CONTROLLER_BUTTON_UP_GPIO
        int "Up Button GPIO Number"
        range 0 48
        default 6
        help
            GPIO number for UP button.

    config DEVICE_CONTROLLER_BUTTON_DOWN_GPIO
        int "Down Button GPIO Number"
        range 0 48
        default 7
        help
            GPIO number for DOWN button.

    config DEVICE_CONTROLLER_BUTTON_LEFT_GPIO
        int "Left Button GPIO Number"
        range 0 48
        default 9
        help
            GPIO number for LEFT button.

    config DEVICE_CONTROLLER_BUTTON_RIGHT_GPIO
        int "Right Button GPIO Number"
        range 0 48
        default 10
        help
            GPIO number for RIGHT button.

    config DEVICE_CONTROLLER_BUTTON_CENTER_GPIO
        int "Center Button GPIO Number"
        range 0 48
        default 8
        help
            GPIO number for CENTER button (OK button with single/double click support).

    config DEVICE_CONTROLLER_BUTTON_ACTIVE_LEVEL
        int "Button Active Level"
        range 0 1
        default 0
        help
            GPIO level when button is pressed down. 0 for active low, 1 for active high.

    config DEVICE_CONTROLLER_LONG_PRESS_TIME_MS
        int "Long Press Time (ms)"
        range 500 5000
        default 1000
        help
            Time in milliseconds to trigger long press event.

    config DEVICE_CONTROLLER_SHORT_PRESS_TIME_MS
        int "Short Press Time (ms)"
        range 50 500
        default 180
        help
            Time in milliseconds to trigger short press event.

    config DEVICE_CONTROLLER_DOUBLE_CLICK_TIME_MS
        int "Double Click Time (ms)"
        range 100 1000
        default 500
        help
            Maximum time in milliseconds between two clicks for double click detection.

    config DEVICE_CONTROLLER_TIMEOUT_MS
        int "Menu Timeout (ms)"
        range 5000 60000
        default 10000
        help
            Timeout in milliseconds for menu navigation and value adjustment states.

    config DEVICE_CONTROLLER_ENABLE_MULTI_DEVICE
        bool "Enable Multi-Device Support"
        default y
        help
            Enable support for managing multiple devices.

    config DEVICE_CONTROLLER_MAX_DEVICES
        int "Maximum Number of Devices"
        depends on DEVICE_CONTROLLER_ENABLE_MULTI_DEVICE
        range 1 10
        default 3
        help
            Maximum number of devices that can be managed.

    config DEVICE_CONTROLLER_BOOT_DISPLAY_TIME_MS
        int "Boot screen display time (ms)"
        default 1500
        range 1000 10000
        help
            Time to display boot logo screen before switching to main application.

endmenu 
```

## vendor_remote/main/Kconfig.projbuild
```kconfig
menu "Smart Home Mesh Roles"

config SH_ROLE_PROVISIONER_CONTROLLER
    bool
    default n

config SH_ROLE_REMOTE_CONTROLLER
    bool
    default y

config SH_ROLE_GATEWAY_RELAY
    bool
    default n

config SH_BLE_BRIDGE_ENABLE
    bool "Enable phone BLE GATT bridge"
    default y
    help
        Expose device list, state notifications, and control writes through a normal BLE GATT service.

endmenu
```

## vendor_remote/sdkconfig.defaults
```kconfig
CONFIG_BT_ENABLED=y
CONFIG_BT_BTU_TASK_STACK_SIZE=4512
# CONFIG_BT_BLE_50_FEATURES_SUPPORTED is not set
CONFIG_BT_BLE_42_FEATURES_SUPPORTED=y
CONFIG_BT_BLE_42_DTM_TEST_EN=y
CONFIG_BT_BLE_42_ADV_EN=y
CONFIG_BT_BLE_42_SCAN_EN=y
CONFIG_BT_GATTS_ENABLE=y
CONFIG_BT_GATTS_SEND_SERVICE_CHANGE_MANUAL=y
CONFIG_BT_GATTC_ENABLE=y
CONFIG_PARTITION_TABLE_CUSTOM=y
CONFIG_PARTITION_TABLE_CUSTOM_FILENAME="partitions.csv"
CONFIG_ESP_MAIN_TASK_STACK_SIZE=8192

CONFIG_BLE_MESH=y
CONFIG_BLE_MESH_NODE=y
# CONFIG_BLE_MESH_PROVISIONER is not set
CONFIG_BLE_MESH_SUPPORT_BLE_ADV=y
CONFIG_BLE_MESH_PB_ADV=y
CONFIG_BLE_MESH_PB_GATT=y
CONFIG_BLE_MESH_GATT_PROXY_SERVER=y
CONFIG_BLE_MESH_TX_SEG_MSG_COUNT=10
CONFIG_BLE_MESH_RX_SEG_MSG_COUNT=10
CONFIG_BLE_MESH_SETTINGS=y
CONFIG_BLE_MESH_STORE_TIMEOUT=0
CONFIG_BLE_MESH_SEQ_STORE_RATE=0
CONFIG_BLE_MESH_RPL_STORE_TIMEOUT=0

CONFIG_SH_ROLE_REMOTE_CONTROLLER=y
CONFIG_SH_BLE_BRIDGE_ENABLE=y

CONFIG_DEVICE_CONTROLLER_BUTTON_UP_GPIO=12
CONFIG_DEVICE_CONTROLLER_BUTTON_DOWN_GPIO=17
CONFIG_DEVICE_CONTROLLER_BUTTON_LEFT_GPIO=18
CONFIG_DEVICE_CONTROLLER_BUTTON_RIGHT_GPIO=13
CONFIG_DEVICE_CONTROLLER_BUTTON_CENTER_GPIO=14
CONFIG_DEVICE_CONTROLLER_BUTTON_ACTIVE_LEVEL=0
CONFIG_DEVICE_CONTROLLER_TIMEOUT_MS=15000
CONFIG_DEVICE_CONTROLLER_ENABLE_MULTI_DEVICE=y
CONFIG_DEVICE_CONTROLLER_MAX_DEVICES=10
```
